; SPI REGISTERS 
SYSCTL_RCGCSSI		EQU		0x400FE61C	
SSI1_BASE			EQU		0x40009000	
SSI1_PRSSI			EQU		0x40009A1C
SSI1_CR1			EQU		0x40009004
SSI1_CPSR			EQU		0x40009010
SSI1_DATA			EQU		0x40009008
	
; GPIO PINS FOR SPI 
GPIO_PORTD_DATA		EQU 0x400073FC ; Access ALL
GPIO_PORTD_CR		EQU 0x40007524 
GPIO_PORTD_LOCK		EQU 0x40007520
GPIO_PORTD_DIR 		EQU 0x40007400 ; Port Direction
GPIO_PORTD_AFSEL	EQU 0x40007420 ; Alt Function enable
GPIO_PORTD_DEN 		EQU 0x4000751C ; Digital Enable
GPIO_PORTD_AMSEL 	EQU 0x40007528 ; Analog enable
GPIO_PORTD_PCTL 	EQU 0x4000752C ; Alternate Functions 

SYSCTL_RCGCGPIO 	EQU 0x400FE608 ; GPIO Gate Control


;LABEL		DIRECTIVE	VALUE		COMMENT
			AREA    	SPI_INIT, READONLY, CODE
			THUMB
			EXPORT  	SPI_INIT ; Make available
			
SPI_INIT_	PROC
			
			; SETUP GPIO PINS 
			
			LDR		R1, =SYSCTL_RCGCGPIO
			LDR		R0, [R1]
			ORR		R0, #0x08 ; ENABLE CLOCK FOR PORTD 
			STR		R0, [R1]
			NOP 
			NOP 
			NOP 
			
			LDR		R1, =GPIO_PORTD_LOCK 
			LDR 	R0, =0x4C4F434B ; SPECIAL UNLOCK ARRAY
			STR		R0, [R1]
			
			LDR		R1, =GPIO_PORTD_CR
			MOV		R0, #0xCF ; COMMIT PORTS PD0,1,2,3
			STR		R0, [R1]
			
			LDR		R1, =GPIO_PORTD_DIR 
			MOV		R0, #0xCF 
			STR		R0, [R1] 
			
			LDR		R1, =GPIO_PORTD_DEN 
			MOV		R0, #0xCF
			STR		R0, [R1] ; DIGITAL ENABLE THE PINS 
			
			LDR		R1, =GPIO_PORTD_AFSEL 
			MOV 	R0, #0x0F 
			STR		R0, [R1] ; ENABLE ALTERNATE FUNCTION FOR SPI PINS  			
			
			LDR		R1, =GPIO_PORTD_PCTL  
			MOV		R0, #0x2222 
			STR		R0, [R1]  
			
			
			LDR 	R1, =SYSCTL_RCGCSSI
			LDR		R0, [R1]
			ORR		R0, #0x02 
			STR		R0, [R1]
			NOP 
			NOP
			NOP 
			NOP 
			NOP 
			
			LDR		R1, =SSI1_CR1 ; DISABLE DURING CONFIG  
			MOV		R0, #0x00 
			STR		R0, [R1]
			
			LDR		R1, =SSI1_CPSR ; PRESCALER 
			MOV		R0, #0x04 
			STR		R0, [R1]
			
			LDR		R1, =SSI1_BASE 
			LDR		R0, [R1]
			BIC 	R0,#0xFF00 ;CLEAR SCR BITS
			BIC 	R0,#0x3F ;Set all bits as 0 
			ORR 	R0,#0x7 ; fresclae and 8 bit data.
			MOV		R0, #0x307 
			
			STR		R0, [R1]
			
			LDR		R1, =SSI1_CR1 
			LDR		R0, [R1]
			ORR		R0, #0x02
			STR		R0, [R1]
			
			
			
			BX LR 
			
		
			ENDP 
			END 