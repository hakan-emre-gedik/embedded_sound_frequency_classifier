GPIO_PORTC_DATA		EQU 	0x400063FC
GPIO_PORTA_ISC 		EQU 	0x4000441C ; Interrupt Clear
GPIO_PORTA_MIS 		EQU 	0x40004418 ; Interrupt Clear

;LABEL		DIRECTIVE	VALUE		COMMENT
			AREA    	POLL_KEYBOARD, READONLY, CODE
			THUMB
			EXPORT 		POLL_KEYBOARD
			IMPORT		TRESHOLD_SETTING_MODE
			IMPORT 		SETTING_MODE
			EXTERN		DEBOUNCE_A 
			EXTERN		KEYBOARD_STATE
			IMPORT		LOW_FREQ_T
			IMPORT		HIGH_FREQ_T
			IMPORT		KEYBOARD_IN_OUT
			EXTERN		DELAY 
			EXTERN		RELEASE_KEYBOARD 
			; IF SPECIFIC KEYS IN THE KEYBOARD ARE PRESSED, INTERRUPT EVERTYHING 
			; AND DETERMINE NEW TRESHOLDS. DEPENDING ON THE SETTING VARIABLE, 
			; LOW OR HIGH TRESHOLD IS ENTERED. FIRST INTERRUPT WILL TAKE LOW 
			; TRESHOLD, SECOND WILL TAKE HIGH, THIRD WILL TAKE LOW, ETC. 
				
POLL_KEYBOARD_ PROC
	
readall		LDR		R1, =GPIO_PORTC_DATA
			LDR		R0, [R1]
			BIC		R0, #0xF0 
			STR		R0, [R1]
			PUSH {R1, R2, R3, R4, LR}
			BL 		DEBOUNCE_A 
			POP {R1, R2, R3, R4, LR}
			
			MVN		R0, R0 
			ANDS 	R0, #0xF0; CHECK IF ANY BUTTON PRESSED
			BXEQ	LR
			BNE 	determiner  
			
determiner 
			LSR 	R0, #4 
			MVN 	R0, R0
			; R2 WILL HOLD THE R VALUE 
			MOV		R2, #0 
loopr		ANDS	R3, R0, #0x01 
			BEQ 	determinel 
			ADDNE	R2, #1 
			LSR		R0, #1 
			BNE		loopr 
			
determinel 	MOV		R3, #0 ; R3 WILL HOLD THE L VALUE 
			LDR		R1, =GPIO_PORTC_DATA
			LDR		R4, =0x10 ; OUTPUT HIGH TO LINE 1 
			
output		MVN		R4, R4 
			STR		R4, [R1] ; GIVE THE OUTPUT 
			MVN 	R4, R4
			
			PUSH {R1, R2, R3, R4, LR}
			BL 		DEBOUNCE_A
			POP {R1, R2, R3, R4, LR}
			
			LSR		R0, #4 
			MVN		R0, R0 
			ANDS 	R0, #0x0F; CHECK WHETHER THE BUTTON PRESSED IN THIS LINE 
			BNE		obtain 
			ADDEQ	R3, #1 
			LSLEQ	R4, #1 ; CHANGE THE LINE 
			BEQ		output


			; AT THIS POINT R VALUE IS IN R2 AND L VALUE IS IN R3 
obtain		CMP		R2, #3 
			BXNE	LR 
			CMP		R3, #3 
			BXNE	LR	
			 
release
			PUSH {R1, R2, R3, R4, LR}
			BL 		DEBOUNCE_A
			POP {R1, R2, R3, R4, LR}
			
			LSR		R0, #4 
			MVN		R0, R0 
			ANDS 	R0, #0x0F; 
			BNE		release	
			
			PUSH {LR}
			BL		KEYBOARD_STATE
			POP {LR}
			LDR		R4, =KEYBOARD_IN_OUT 
			MOV		R5, #0x01 
			STR		R5, [R4]
			
			PUSH {LR}
			BL RELEASE_KEYBOARD
			POP {LR}
			
			BX LR 
			ENDP 