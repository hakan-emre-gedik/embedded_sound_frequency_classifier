
;LABEL		DIRECTIVE	VALUE		COMMENT
			AREA    	FFT_MAGNITUDE, READONLY, CODE
			THUMB
			EXPORT  	FFT_MAGNITUDE; Make available
			EXTERN		arm_cfft_q15 
			EXTERN		arm_cfft_sR_q15_len256
			EXTERN		OutChar
			EXTERN		OutStr
			EXTERN		CONVRT
			IMPORT 		DOMINANT_FREQUENCY 
			IMPORT		DOMINANT_MAGNITUDE
			IMPORT 		MIC_READINGS 
			

			; PERFORM A READING FROM ADC MODULE AND STORE IT
			; ADC RAW SAMPLING FREQUENCY IS SET TO BE THE 
			; MINIMUM VALUE OF 125KSPS, WHICH IS SIGNIFICANTLY 
			; HIGHER THAN THE MINIMUM RATE OF READING THE 
			;DATA DIRECTLY 
FFT_MAGNITUDE_ PROC
			LDR		R0, =arm_cfft_sR_q15_len256
			LDR		R1, =MIC_READINGS ; ARRAY OF THE READINGS 
			MOV		R2, #0 ; IFFT FLAG 
			MOV		R3, #1 
			
			PUSH{R1, LR} 
			BL arm_cfft_q15			
			POP {R1, LR}
			
			; IN THE TABLE, WE HAVE 256 SAMPLES FROM THE FFT OF INPUT 
			; SIGNAL. EACH 4-BYTE MEMORY LOCATION HOLDS THE REAL PART
			; OF THE DFT AT SIGNIFICANT 2-BYTES AND THE IMAGINARY PART
			; IN THE LEAST SIGNIFICANT TWO-BYTES. USING THIS INFORMATION, 
			; CALCULATE THE FFT MAGNITUDE AT EACH POINT AND STORE THE 
			; RESULT TO THE SAME TABLE THAT THE INITIAL READINGS ARE TAKEN TO 
			MOV		R5, #0 
			MOV		R0, #0 ; USE AS A POINTER ON THE TABLE 
			LDR		R4, =0xFFFF
loop		LDR		R2, [R1, R0] ; WILL HOLD THE REAL PART 
			MOV		R3, R2 ; WILL HOLD THE IMAGINARY PART 
			LSR		R2, #16 ; 
			SXTAH 	R2, R5, R2; SIGN EXTEND THE VALUE 
			MOVS	R2, R2
			MVNMI	R2, R2
			AND		R3, R4 ; TAKE THE LEAST SIGNIFICANT HALF  
			SXTAH 	R3, R5, R3 
			MOVS	R3, R3 
			MVNMI	R3, R3
			MUL		R2, R2 ; TAKE THE SQUARE OF THE REAL PART 
			LSR		R2, #16 ; LOSE ONE DIGIT PRECISION TO PREVENT OVERFLOW 
			MUL		R3, R3 ; TAKE THE SQUARE OF THE IMAGINARY PART 
			LSR		R3, #16 ; 
			ADD		R2, R3 ; MAGNITUDE SQUARE IS IN R2 
			STR		R2, [R1, R0]
			ADD		R0, #4 
			CMP 	R0, #1024 
			BNE		loop 
			
			; THE STORED VALUES ARE MAGNITUDE^2/2, WHICH IS DONE TO PREVENT 
			; OVERFLOW. SINCE WE ONLY NEED TO DETERMINE THE FREQUENCY WITH 
			; HIGHEST MAGNITUDE, THIS IS NOT A SIGNIFICANT PROBLEM
			
			; DETERMINE THE HIGHEST FREQUENCY COMPONENET. 
			LDR		R1, =MIC_READINGS ; 
			MOV		R0, #0
			MOV		R4, #0
			LDR		R2, [R1, #0]
			
loop_max	LDR		R3, [R1, R4]
			CMP		R3, R2 
			MOVPL 	R0, R4
			MOVPL	R2, R3 
			ADD		R4, #4 
			CMP		R4, #512 
			BNE		loop_max 
			
			LDR		R2, [R1, R0] ; R1 LATER WILL HOLD THE MAGNITUDE VALUE  
			
			LSR		R0, #2 ; DIVIDE BY 4 TO FIND THE TRUE INDEX 
			; CONVERT R0 IN HZ FORM. TO DO THAT, MULTIPLY IT BY 1000
			; AND DIVIDE IT BY 128, SINCE MAXIMUM SAMPLING FREQUENCY 
			; IS 1KHZ 
			
			LDR		R1,  =1000 
			MUL		R0, R1 
			LSR		R0, #7  
			
			MOV		R1, R2 
			
			PUSH {LR, R0, R1}
			MOV		R4, R0
			LDR		R5, =DOMINANT_FREQUENCY 
			BL		CONVRT 
			POP{LR, R0, R1}
			
			PUSH {LR, R0, R1}
			MOV		R4, R1
			LDR		R5, =DOMINANT_MAGNITUDE 
			BL		CONVRT 
			POP{LR, R0, R1}
			
			
			
			; R0 WILL RETURN THE FREQUENCY VALUE WHERE R1 WILL HOLD 
			; THE MAGNITUDE OF THAT FREQUENCY IN THE FFT 
			BX LR 
			ENDP 
END 