;GPIO Registers
GPIO_PORTA_DATA		EQU 0x400043FC ; Access ALL
GPIO_PORTA_CR		EQU 0x40004524 
GPIO_PORTA_LOCK		EQU 0x40004520
GPIO_PORTA_DIR 		EQU 0x40004400 ; Port Direction
GPIO_PORTA_AFSEL	EQU 0x40004420 ; Alt Function enable
GPIO_PORTA_DEN 		EQU 0x4000451C ; Digital Enable
GPIO_PORTA_AMSEL 	EQU 0x40004528 ; Analog enable
GPIO_PORTA_PCTL 	EQU 0x4000452C ; Alternate Functions
GPIO_PORTA_PUR_R	EQU 0x40004510 ; Pull-up Resistors
GPIO_PORTA_IS	 	EQU 0x40004404 ; Interrupt sense 
GPIO_PORTA_IBE	 	EQU 0x40004408 ; Interrupt both edges
GPIO_PORTA_IEV	 	EQU 0x4000440C ; Interrupt event 
GPIO_PORTA_IM	 	EQU 0x40004410 ; Interrupt mask 
GPIO_PORTA_ISC 		EQU 0x4000461C ; Interrupt Clear

GPIO_PORTC_DATA		EQU 0x400063FC ; Access ALL
GPIO_PORTC_CR		EQU 0x40006524 
GPIO_PORTC_LOCK		EQU 0x40006520
GPIO_PORTC_DIR 		EQU 0x40006400 ; Port Direction
GPIO_PORTC_AFSEL	EQU 0x40006420 ; Alt Function enable
GPIO_PORTC_DEN 		EQU 0x4000651C ; Digital Enable
GPIO_PORTC_AMSEL 	EQU 0x40006528 ; Analog enable
GPIO_PORTC_PCTL 	EQU 0x4000652C ; Alternate Functions
GPIO_PORTC_PUR_R	EQU 0x40006510 ; Pull-up Resistors
GPIO_PORTC_IS	 	EQU 0x40006404 ; Interrupt sense 
GPIO_PORTC_IBE	 	EQU 0x40006408 ; Interrupt both edges
GPIO_PORTC_IEV	 	EQU 0x4000640C ; Interrupt event 
GPIO_PORTC_IM	 	EQU 0x40006410 ; Interrupt mask


SYSCTL_RCGCGPIO 	EQU 0x400FE608 ; GPIO Gate Control

; NVIC ENABLE AND SET PRIORITY REGISTERS 
NVIC_EN 			EQU 0xE000E100 
NVIC_GPIO_PORTA_PRI EQU 0xE000E410

;LABEL		DIRECTIVE	VALUE		COMMENT
			AREA    	KEYBOARD_PINS_INIT, READONLY, CODE
			THUMB
			EXPORT  	KEYBOARD_PINS_INIT ; Make available
; PORTB PB0,1,2,3, ARE USED FOR THE STEP MOTOR DRIVER


KEYBOARD_PINS_INIT_	PROC
			; INITIALIZE UPPER ORDER PINS OF PORT A AND PORT C
			; FOR THE KEYBOARD 
			LDR		R1, =SYSCTL_RCGCGPIO; ACTIVATE CLOCK 
			LDR		R0, [R1] 
			ORR		R0, #0x05 ; ENABLE PORT A AND C 
			STR		R0, [R1]
			NOP
			NOP 
			NOP 
				
			LDR		R1, =GPIO_PORTA_LOCK ; UNLCOK THE PORT 
			LDR 	R0, =0x4C4F434B ; SPECIAL UNLOCK ARRAY 
			STR		R0, [R1]
			
			LDR		R1, =GPIO_PORTC_LOCK ; UNLCOK THE PORT 
			LDR 	R0, =0x4C4F434B ; SPECIAL UNLOCK ARRAY 
			STR		R0, [R1]
				
			LDR 	R1, =GPIO_PORTA_CR; COMMIT THE PORTS 
			LDR		R0, =0xFE ;  
			STR		R0, [R1]
			
			LDR 	R1, =GPIO_PORTC_CR; COMMIT THE PORTS 
			LDR		R0, =0xF0 
			STR		R0, [R1]
				
			LDR 	R1, =GPIO_PORTA_DIR
			LDR		R0, [R1]
			BIC		R0, #0xF8
			ORR		R0, #0x06 
			STR		R0, [R1]
			
			LDR 	R1, =GPIO_PORTC_DIR
			LDR		R0, [R1]
			ORR		R0, #0xF0
			STR		R0, [R1]

			LDR		R1, =GPIO_PORTA_AFSEL ; HANDLE ALTERNATIVE FUNCTION SELECT 
			LDR		R0, [R1]
			BIC 	R0, #0xFE ; SET ALL AS STANDARD GPIO 
			STR		R0, [R1]
			
			LDR		R1, =GPIO_PORTC_AFSEL ; HANDLE ALTERNATIVE FUNCTION SELECT 
			LDR		R0, [R1]
			BIC 	R0, #0xF0 ; SET ALL AS STANDARD GPIO 
			STR		R0, [R1]
				
			LDR 	R1, =GPIO_PORTA_DEN ; DIGITAL ENABLE FOR ALL THE PINS 
			LDR		R0, [R1]
			ORR 	R0, #0xFE ; ENABLE THEM ALL 
			STR		R0, [R1]
			
			LDR 	R1, =GPIO_PORTC_DEN ; DIGITAL ENABLE FOR ALL THE PINS 
			LDR		R0, [R1]
			ORR 	R0, #0xF0 ; 
			STR		R0, [R1]
			
			LDR		R1, =GPIO_PORTA_PUR_R	
			LDR		R0, [R1]
			ORR		R0, #0xF8
			STR		R0, [R1]
			
			LDR		R1, =GPIO_PORTA_IS 
			LDR		R0, [R1]
			ORR		R0, #0x08 
			STR		R0, [R1]
			
			;LDR		R1, =GPIO_PORTA_IBE 
			;LDR		R0, [R1]
			;BIC		R0, #0x08 
			;STR		R0, [R1]
			
			LDR		R1, =GPIO_PORTA_IEV 
			LDR		R0, [R1]
			BIC		R0, #0x08 
			STR		R0, [R1]
			
			LDR		R1, =GPIO_PORTA_IM
			MOV		R0, #0x08 
			STR		R0, [R1]
			
			; CONFIGURE NVIC FOR THE INTERRUPT 
			MOV		R0, #0x00 
			LDR 	R1, =NVIC_EN
			ORR 	R0, #0x01 
			LSL 	R0, #0 ; INTERRUPT NUMBER FOR GPIOA
			LDR 	R2, [R1]
			ORR		R0, R2 
			;STR		R0, [R1]
			
			LDR		R1, =NVIC_GPIO_PORTA_PRI
			LDR		R0, [R1]
			MOV		R0, #7 
			LSL		R0, #5 
			LDR 	R2, [R1]
			ORR		R0, R2 
			STR		R0, [R1]
			
			LDR		R1, =GPIO_PORTA_DATA
			LDR		R0, [R1]
			ORR		R0, #0x04 
			STR		R0, [R4]
			
			LDR		R1, =GPIO_PORTA_ISC
			MOV		R0, #0x08
			STR		R0, [R1]
			
			BX LR 
			ENDP 
	
	