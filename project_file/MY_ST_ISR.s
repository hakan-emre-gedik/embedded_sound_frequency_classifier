ADC0_SSFIFO3 	EQU 0x400380A8 ; Channel 3 results
ADC0_RIS 		EQU 0x40038004 ; Interrupt status
ADC0_PSSI 		EQU 0x40038028 ; Initiate sample
ADC0_ISC		EQU 0x4003800C ; Interrupt status clear

;LABEL		DIRECTIVE	VALUE		COMMENT
				AREA        MEMORY_FOR_READINGS, DATA, READWRITE 
				THUMB
MIC_READINGS 	FILL 	1024
CURRENT_PTR		FILL	4
READ_COMPLETE 	FILL	4 

;LABEL		DIRECTIVE	VALUE		COMMENT
			AREA    	MY_ST_ISR, READONLY, CODE
			THUMB
			EXPORT  	MY_ST_ISR	; Make available
			EXPORT 		CURRENT_PTR
			EXPORT 		READ_COMPLETE
			EXPORT 		MIC_READINGS
			EXTERN		TIMERS_INIT
			
			
			; PERFORM A READING FROM ADC MODULE AND STORE IT
			; ADC RAW SAMPLING FREQUENCY IS SET TO BE THE 
			; MINIMUM VALUE OF 125KSPS, WHICH IS SIGNIFICANTLY 
			; HIGHER THAN THE MINIMUM RATE OF READING THE 
			;DATA DIRECTLY 
MY_ST_ISR_	PROC
			; CHECK WHETHER A READING SHOULD BE TAKEN 
			LDR		R1, =READ_COMPLETE 
			LDR		R0, [R1]
			CMP 	R0, #1 
			BXEQ LR 
			
			; START SAMPLING ROUTINE 
			LDR		R3, =ADC0_RIS ; INT ADDRESS 
			LDR		R4, =ADC0_SSFIFO3 ; RESULT ADDRESS 
			LDR		R2, =ADC0_PSSI ; SAMPLING SEQUENCE INITIATE 
			LDR		R6, =ADC0_ISC 
			
sample 		LDR		R0, [R2]
			ORR		R0, R0, 0x08 ; SET BIT 3 FOR PSSI 
			STR		R0, [R2] 
check 		LDR		R0, [R3]
			ANDS	R0, #0x08
			BEQ		check 
			; READ THE DATA 
			LDR		R0, [R4]
			SUB		R0, #1475 ; SUBTRACT THE 1.25V MIC OFFSET 
			LSL 	R0, #4 ; SHIFT THE RESULT BY 16 BITS 
							; FOR THE FFT FUNCTION INPUT 
							; FORMAT (RE=M[31:16] + IM=M[15:0]) 
			
			LDR 	R1, =MIC_READINGS
			LDR		R2, =CURRENT_PTR
			LDR		R3, [R2]
			CMP		R3, #512 ; OVERFLOW FOR THE MEMORY   
			BEQ		all_read
			
			ADD		R1, R3 ; FIND THE CURRENT LOCATION OF THE READINGS  
			STR		R0, [R1] ; STORE THE READING 
			ADD		R3, #4 ; INCREASE THE CURRENT PTR BY ONE 
			STR		R3, [R2] ; STORE THE CURRENT PTR 
			
			LDR		R0, [R6]
			ORR		R0, #0x08 ; CLEAR THE INTERRUPT USING ADC_ISC REGISTER
			STR		R0, [R6]
			
			BX LR 
			
all_read	
			MOV		R3, #0 
			STR		R3, [R2]
			LDR		R2, =READ_COMPLETE 
			MOV		R1, #1
			STR		R1, [R2]
			
			LDR		R0, [R6]
			ORR		R0, #0x08 ; CLEAR THE INTERRUPT USING ADC_ISC REGISTER
			STR		R0, [R6]
			BX LR 
			
			
			ENDP 
END 
			